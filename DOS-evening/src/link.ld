OUTPUT_FORMAT("elf32-i386")     /* Формат вывода ELF 32 бита для архитектуры x86 */
ENTRY(_start)                   /* Указывает на точку входа программы */


SECTIONS {
    . = 1M;                     /* Устанавливает адрес загрузки ядра на 1 МБ */

    
    .text BLOCK(4K) : ALIGN(4K) {
        *(.multiboot)           /* Секция multiboot */
        *(.text)                /* Секция кода */
    }

    .rodata BLOCK(4K) : ALIGN(4K) {
        *(.rodata)              /* Секция только для чтения */
    }

    .data BLOCK(4K) : ALIGN(4K) {
        *(.data)                /* Секция данных */
    }

    .bss BLOCK(4K) : ALIGN(4K) {
        *(COMMON)               /* Секция неинициализированных данных */
        *(.bss) 
    }

    /DISCARD/ : {
        *(.comment)             /* не хранить в итоговом файле */
    }
}

/*
    Этот скрипт линковки используется для компоновки загрузчика операционной системы. Вот пояснения для каждой строки:

    - ENTRY(_start) указывает на точку входа в программу, которая должна быть помечена меткой "_start". Это гарантирует, что программа начнет свое выполнение с этой точки.

    - SECTIONS { ... } - группирует различные секции в один блок.

    - . = 1M; устанавливает адрес загрузки на 1 МБ. Это необходимо для того, чтобы загрузчик операционной системы не мешал другим программам, которые могут быть загружены в память.

    - .text BLOCK(4K) : ALIGN(4K) {
        *(.text) 
    } - это секция заголовка multiboot, которая содержит информацию для загрузчика

    - .text BLOCK(4K) : ALIGN(4K) {
        *(.text) 
    } - это секция кода, которая содержит код операционной системы. ALIGN (4K) выравнивает секцию по границе страницы (4 КБ), что обеспечивает лучшую производительность, а *(.text) включает в себя код самой операционной системы.

    - .rodata BLOCK(4K) : ALIGN(4K) {
        *(.rodata) 
    } - это секция только для чтения, которая содержит данные, которые не могут быть изменены во время выполнения программы.

    - .data BLOCK(4K) : ALIGN(4K) {
        *(.data) 
    } - это секция данных, которая содержит данные, которые могут быть изменены во время выполнения программы.

    - .bss BLOCK(4K) : ALIGN(4K) {
        *(COMMON) *(.bss) 
    } - это секция неинициализированных данных, которая содержит данные, которые не были явно инициализированы в программе. *(COMMON) включает общие неинициализированные данные, а *(.bss) включает все остальные неинициализированные данные.


*/